#pragma once
// Generated by quant_exact.py for Noodle2 v0.1.18 / PSRAM-patched runtime.
// model has 2-channel CHW input (IR,RED); 256 samples at 100Hz.
// Each layer: symmetric int8 weights + little-endian int32 biases.
// NOODLE2 trained model; export only, requires host cross-validation.
#include <Noodle2.h>
#if defined(ARDUINO_ARCH_ESP8266)
#include <pgmspace.h>
#endif
namespace peaknet_ppg {
// ESP8266 requires explicit PROGMEM to retain model bytes in program Flash.
#if defined(ARDUINO_ARCH_ESP8266)
#define PEAKNET_FLASH PROGMEM
#else
#define PEAKNET_FLASH
#endif
static const uint8_t data[5188] PEAKNET_FLASH = {
    9, 236, 219, 47, 36, 247, 22, 57, 239, 239, 32, 38, 249, 37, 202, 49, 22, 57, 87, 240, 38, 30,
    3, 60, 19, 13, 242, 14, 23, 5, 19, 9, 37, 228, 40, 31, 162, 222, 231, 252, 17, 2, 18, 66,
    78, 224, 218, 246, 243, 255, 43, 44, 239, 33, 195, 249, 206, 1, 2, 217, 1, 200, 129, 202, 28, 242,
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    37, 252, 240, 167, 206, 80, 179, 207, 191, 69, 127, 166, 83, 70, 209, 255, 255, 255,
};
#undef PEAKNET_FLASH
struct Model {
    noodle2::NoodleBuffer storage;
    noodle2::NoodleParams conv01;
    noodle2::NoodleParams conv02;
    noodle2::NoodleParams conv03;
    noodle2::NoodleParams conv04;
    noodle2::NoodleParams conv05;
    noodle2::NoodleParams conv06;
    Model() :
      conv01(0,144,144,8,noodle2::Quant(1575265749L,-9)),
      conv02(0,896,896,16,noodle2::Quant(1310663387L,-8)),
      conv03(0,1792,1792,16,noodle2::Quant(1889835449L,-9)),
      conv04(0,1792,1792,16,noodle2::Quant(1784812056L,-8)),
      conv05(0,256,256,16,noodle2::Quant(1750555903L,-7)),
      conv06(0,16,16,1,noodle2::Quant(1838298508L,-6)) {}
    noodle2::Status bind_flash() {
        noodle2::Status st=storage.bind_flash(data,sizeof(data));
        if(st==noodle2::OK) st=conv01.bind(storage,0);
        if(st==noodle2::OK) st=conv02.bind(storage,176);
        if(st==noodle2::OK) st=conv03.bind(storage,1136);
        if(st==noodle2::OK) st=conv04.bind(storage,2992);
        if(st==noodle2::OK) st=conv05.bind(storage,4848);
        if(st==noodle2::OK) st=conv06.bind(storage,5168);
        return st;
    }
};
} // namespace peaknet_ppg
